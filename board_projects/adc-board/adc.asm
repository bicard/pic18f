#include P18F4520.INC

dCnt1 EQU  84H
dCnt2 EQU  85H
VAL	  EQU  0X20

	ORG 0
	CLRF PCLATH
	GOTO START
	
	ORG 0X30
START 

; ADC SETUP
	MOVLW 0X00
	MOVWF ADCON1
	MOVLW 0X92
	MOVWF ADCON2

; SERIAL PORT
	MOVLW 0X20
	MOVWF TXSTA
	BSF TXSTA, BRGH
	MOVLW 0X81
	MOVWF SPBRG
	BSF TRISC, TX
	BSF RCSTA, SPEN
	
AGAIN
	MOVLW 0X11
	MOVWF ADCON0
	CALL DELAY
	BSF ADCON0, 1
LOOP
	BTFSC ADCON0, 1
	BRA LOOP

	MOVWF ADRESH, W
	ANDLW h'3'
	MOVWF VAL
	;CALL CHKVAL
	CALL TXMIT
	
	SWAPF ADRESL, 0
	ANDLW h'F'
	MOVWF VAL
	;CALL CHKVAL
	CALL TXMIT

	MOVF ADRESL, 0
	ANDLW h'F'
	MOVWF VAL
	;CALL CHKVAL
	CALL TXMIT
	
	MOVLW a' '
	CALL TXMIT 

	BRA AGAIN

CHKVAL
	MOVLW 0XA
	SUBWF VAL
	BTFSC STATUS, C
	BRA VALATOF
	BRA VALZTON

VALATOF
	MOVLW h'A'
	SUBWF VAL, 1
	MOVLW 'A'
	ADDWF VAL, 0
	RETURN

VALZTON
	MOVLW 0
	ADDWF VAL, 0
	RETURN	

TXMIT
	ADDLW 0X30
	MOVWF TXREG
L1	BTFSS PIR1, TXIF
	BRA L1
	RETURN

DELAY						;delay sub-routine
	MOVLW 0XFF
	MOVWF dCnt1			;load 0xff to dCnt1
D2	MOVWF dCnt2			;load 0xff to dCnt2
D1	DECFSZ dCnt2,1		;decrement dCnt2 and skip if zero
	GOTO D1				;jump to label D1
	DECFSZ dCnt1,1		;decrement dCnt1 and skip if zero
	GOTO D2				;jump to label D2
	RETURN

	END