#include P18F4520.inc
					
CNT1	EQU		0X20
CNT2	EQU		0X21


		ORG 0X0
		CLRF PCLATH
		GOTO START

		ORG 0X30
START	CLRF TRISB
		

AGAIN	MOVLW 0X00
		MOVWF PORTB
	
		BSF PORTB, 0
		CALL DELAY
		CALL DELAY
		CALL DELAY
	    MOVWF PORTB
		BSF PORTB, 1
		CALL DELAY
		CALL DELAY
		CALL DELAY
		MOVWF PORTB
		BSF PORTB, 2
		CALL DELAY
		CALL DELAY
		CALL DELAY
		MOVWF PORTB
		BSF PORTB, 3
		CALL DELAY
		CALL DELAY
		CALL DELAY
		MOVWF PORTB
		BSF PORTB, 4
		CALL DELAY
		CALL DELAY
		CALL DELAY
		MOVWF PORTB
		BSF PORTB, 5
		CALL DELAY
		CALL DELAY
		CALL DELAY
		MOVWF PORTB
		BSF PORTB, 6
		CALL DELAY
		CALL DELAY
		CALL DELAY
		MOVWF PORTB
		BSF PORTB, 7
		CALL DELAY
		CALL DELAY
		CALL DELAY

		BRA AGAIN
		
		

DELAY	MOVLW 0XFF
		MOVWF CNT1
LOOP1	MOVWF CNT2	
LOOP2	DECF CNT2, F
		BNZ LOOP2
		DECF CNT1, F
		BNZ LOOP1

		
		RETURN
		
		
		END